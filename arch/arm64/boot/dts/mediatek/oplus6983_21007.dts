// SPDX-License-Identifier: (GPL-2.0 OR MIT)
/*
 * Copyright (C) 2020 MediaTek Inc.
 */
/dts-v1/;
/plugin/;

&odm {
/*OPLUS_BUG_STABILITY oplus project start */
	oplus_project:oplus_project {
		compatible = "oplus,oplus_project";
	};
/*endif*/

	oplus_boardid:oplus_boardid {
		compatible = "oplus,oplus_boardid";
		oplus_boardid,dtsino="21007";//only one u32
		oplus_boardid,pcbmask="0xffff";//all mask 0xffff
	};
};

#include <k6983v1_64/cust.dtsi>
